## config/boards/shields/KobitoKey/Kconfig.defconfig
```kconfig
# Bluetoothの接続インターバルを最小にする（遅延改善）
CONFIG_BT_PERIPHERAL_PREF_MIN_INT=12
CONFIG_BT_PERIPHERAL_PREF_MAX_INT=12

#Bluetooth送信出力最大化(遅延改善)
CONFIG_BT_CTLR_TX_PWR_PLUS_8=y

# 左（central）
if SHIELD_KOBITOKEY_LEFT
config ZMK_KEYBOARD_NAME
    default "KobitoKey"
endif

# 左右共通
if SHIELD_KOBITOKEY_LEFT || SHIELD_KOBITOKEY_RIGHT
config ZMK_SPLIT
    default y
config ZMK_POINTING
    default y
config SPI
    default y
endif
```
